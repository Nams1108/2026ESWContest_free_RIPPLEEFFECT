#include <Arduino.h>
#include <ESP_I2S.h>

// ============================================================
// XIAO ESP32-C3 -> PCM5102A
// ============================================================
static const int PIN_BCLK = 3;   // D1
static const int PIN_LRCK = 4;   // D2
static const int PIN_DOUT = 5;   // D3 -> PCM5102A DIN

I2SClass I2S;

// ============================================================
// AUDIO PARAMETERS
// ============================================================
static const uint32_t SAMPLE_RATE = 48000;

static const uint32_t TONE_FRAMES       = 12000;  // 250 ms
static const uint32_t GUARD_FRAMES      = 4800;   // 100 ms
static const uint32_t PACKET_GAP_FRAMES = 48000;  // 1.0 s

// 전원 인가 후 DAC 안정화용. 더 줄이고 싶으면 2400(50ms)까지 시험 가능.
static const uint32_t STARTUP_SILENCE_FRAMES = 4800; // 100 ms

// X waveform repeats exactly every 480 samples (10 ms).
// Y waveform repeats exactly every 960 samples (20 ms).
// Tables are generated offline, so ESP32 performs NO sinf()/float calculation at boot/runtime.

static const int16_t X_TABLE[480] = {
  0, 755, 1501, 2233, 2940, 3618, 4258, 4854, 5400, 5891, 6322, 6690, 6991, 7223, 7385, 7476,
  7496, 7446, 7328, 7146, 6901, 6600, 6245, 5843, 5400, 4921, 4413, 3884, 3339, 2786, 2232, 1684,
  1148, 630, 136, -328, -759, -1150, -1500, -1805, -2063, -2272, -2433, -2544, -2608, -2625, -2598, -2530,
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  -7496, -7476, -7385, -7223, -6991, -6690, -6322, -5891, -5400, -4854, -4258, -3618, -2940, -2233, -1501, -755
};

static const int16_t Y_TABLE[960] = {
  0, 916, 1818, 2695, 3532, 4319, 5045, 5698, 6272, 6757, 7147, 7439, 7630, 7717, 7702, 7586,
  7372, 7067, 6676, 6207, 5668, 5071, 4424, 3740, 3030, 2306, 1578, 860, 160, -509, -1138, -1720,
  -2245, -2709, -3107, -3433, -3687, -3868, -3977, -4014, -3985, -3892, -3743, -3543, -3299, -3021, -2717, -2394,
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  -7372, -7586, -7702, -7717, -7630, -7439, -7147, -6757, -6272, -5698, -5045, -4319, -3532, -2695, -1818, -916
};


// ============================================================
// I2S TX BUFFER
// ============================================================
static const uint32_t CHUNK_FRAMES = 1024;
static int16_t stereoBuffer[CHUNK_FRAMES * 2];

static void writeStereoFrames(uint32_t frames)
{
  const size_t bytes = frames * 2 * sizeof(int16_t);
  size_t written = I2S.write((uint8_t *)stereoBuffer, bytes);

  if (written != bytes)
  {
    Serial.print("I2S short write: ");
    Serial.print(written);
    Serial.print(" / ");
    Serial.println(bytes);
  }
}

// ============================================================
// PLAY PERIODIC TABLE
// ============================================================
static void playPeriodicTable(
  const int16_t *table,
  uint32_t periodFrames,
  uint32_t totalFrames
)
{
  uint32_t sent = 0;
  uint32_t tablePos = 0;

  while (sent < totalFrames)
  {
    uint32_t remain = totalFrames - sent;
    uint32_t n = (remain > CHUNK_FRAMES) ? CHUNK_FRAMES : remain;

    for (uint32_t i = 0; i < n; i++)
    {
      int16_t s = table[tablePos] >> 1;

      stereoBuffer[i * 2]     = s;
      stereoBuffer[i * 2 + 1] = s;

      tablePos++;
      if (tablePos >= periodFrames)
        tablePos = 0;
    }

    writeStereoFrames(n);
    sent += n;
  }
}

static void playSilence(uint32_t totalFrames)
{
  memset(stereoBuffer, 0, sizeof(stereoBuffer));

  uint32_t sent = 0;

  while (sent < totalFrames)
  {
    uint32_t remain = totalFrames - sent;
    uint32_t n = (remain > CHUNK_FRAMES) ? CHUNK_FRAMES : remain;

    writeStereoFrames(n);
    sent += n;
  }
}

// ============================================================
// BEACON
// ============================================================
static void playX()
{
  playPeriodicTable(X_TABLE, 480, TONE_FRAMES);
}

static void playY()
{
  playPeriodicTable(Y_TABLE, 960, TONE_FRAMES);
}

static void playPacket()
{
  playX();
  playSilence(GUARD_FRAMES);

  playY();
  playSilence(GUARD_FRAMES);

  playX();
  playSilence(GUARD_FRAMES);

  playY();
  playSilence(GUARD_FRAMES);
}

// ============================================================
// SETUP
// ============================================================
void setup()
{
  Serial.begin(115200);

  I2S.setPins(
    PIN_BCLK,
    PIN_LRCK,
    PIN_DOUT,
    -1,
    -1
  );

  bool ok = I2S.begin(
    I2S_MODE_STD,
    SAMPLE_RATE,
    I2S_DATA_BIT_WIDTH_16BIT,
    I2S_SLOT_MODE_STEREO
  );

  if (!ok)
  {
    Serial.println("I2S begin FAILED");
    while (1) delay(1000);
  }

  Serial.println("I2S begin PASS");
  Serial.println("No startup sine calculation");
  Serial.println("X = 500 + 900 Hz");
  Serial.println("Y = 650 + 1050 Hz");

  // PCM5102A settle time only
  playSilence(STARTUP_SILENCE_FRAMES);
}

// ============================================================
// LOOP
// ============================================================
void loop()
{
  playPacket();
  playSilence(PACKET_GAP_FRAMES);
}